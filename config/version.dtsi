#define VERSION_MACRO
macro_ver: macro_ver {
compatible = "zmk,behavior-macro";
#binding-cells = <0>;
bindings = <&kp N2>, <&kp N0>, <&kp N2>, <&kp N5>, <&kp N0>, <&kp N7>, <&kp N3>, <&kp N0>, <&kp MINUS>, <&kp T>, <&kp O>, <&kp M>, <&kp Z>, <&kp MINUS>, <&kp N6>, <&kp C>, <&kp N1>, <&kp E>, <&kp N0>, <&kp N1>, <&kp A>, <&kp MINUS>, <&kp C>, <&kp L>, <&kp I>, <&kp Q>, <&kp U>, <&kp E>, <&kp RET>;
};
